## base_external/Config.in
```kconfig
source "$BR2_EXTERNAL_project_base_PATH/package/thermometer-client/Config.in"
source "$BR2_EXTERNAL_project_base_PATH/package/thermometer-device/Config.in"
```

## base_external/package/thermometer-client/Config.in
```kconfig
config BR2_PACKAGE_THERMOMETER_CLIENT
	bool "thermometer-client"
    depends on BR2_PACKAGE_HOST_RUSTC_TARGET_ARCH_SUPPORTS
 	select BR2_PACKAGE_HOST_RUSTC
	help
	  Builds the thermometer client for sending temperature data to a Home Assistant server on the network.
```

## base_external/package/thermometer-device/Config.in
```kconfig
config BR2_PACKAGE_THERMOMETER_DEVICE
	bool "thermometer-device"
	help
	  Builds the thermometer device drivers for reading
      actual temperature data
```

## meta-thermometer/conf/layer.conf
```bitbake
# We have a conf and classes directory, add to BBPATH
BBPATH .= ":${LAYERDIR}"

# We have recipes-* directories, add to BBFILES
BBFILES += "${LAYERDIR}/recipes-*/*/*.bb \
            ${LAYERDIR}/recipes-*/*/*.bbappend"

BBFILE_COLLECTIONS += "meta-thermometer"
BBFILE_PATTERN_thermometer = "^${LAYERDIR}/"
BBFILE_PRIORITY_thermometer = "6"

LAYERDEPENDS_thermometer = "core"
LAYERSERIES_COMPAT_thermometer = "scarthgap"
```

## rpi-build/conf/bblayers.conf
```bitbake
# POKY_BBLAYERS_CONF_VERSION is increased each time build/conf/bblayers.conf
# changes incompatibly
POKY_BBLAYERS_CONF_VERSION = "2"

BBPATH = "${TOPDIR}"
BBFILES ?= ""

BBLAYERS ?= " \
  /home/smsweet/repos/final-project-smsweet66/poky/meta \
  /home/smsweet/repos/final-project-smsweet66/poky/meta-poky \
  /home/smsweet/repos/final-project-smsweet66/poky/meta-yocto-bsp \
  /home/smsweet/repos/final-project-smsweet66/meta-thermometer \
  "
```
